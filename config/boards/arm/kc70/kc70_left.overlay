#include "kc70.dtsi"

&kscan0 {
    row-gpios
        = <&gpio1 11 (GPIO_ACTIVE_HIGH | GPIO_PULL_DOWN)> // Row 1 from the schematic file
        , <&gpio0 3 (GPIO_ACTIVE_HIGH | GPIO_PULL_DOWN)> // Row 2 from the schematic file
        , <&gpio0 7 (GPIO_ACTIVE_HIGH | GPIO_PULL_DOWN)> // Row 3 from the schematic file
        , <&gpio0 4 (GPIO_ACTIVE_HIGH | GPIO_PULL_DOWN)> // Row 4 from the schematic file
        , <&gpio0 5 (GPIO_ACTIVE_HIGH | GPIO_PULL_DOWN)> // Row 5 from the schematic file
        ;
    col-gpios
        = <&gpio1 10 GPIO_ACTIVE_HIGH> // col1 in the schematic
        , <&gpio0 28 GPIO_ACTIVE_HIGH> // col2 in the schematic
        , <&gpio1 13 GPIO_ACTIVE_HIGH> // col3 in the schematic
        , <&gpio0 2 GPIO_ACTIVE_HIGH> // col4 in the schematic
        , <&gpio0 29 GPIO_ACTIVE_HIGH> // col5 in the schematic
        , <&gpio0 31 GPIO_ACTIVE_HIGH> // col6 in the schematic
        ;
};
