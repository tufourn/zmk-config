## config/boards/arm/kc70/Kconfig.board
```kconfig
config BOARD_KC70_LEFT
    bool "kc70_left"
    depends on SOC_NRF52840_QIAA

config BOARD_KC70_RIGHT
    bool "kc70_right"
    depends on SOC_NRF52840_QIAA
```

## config/boards/arm/kc70/Kconfig.defconfig
```kconfig
if BOARD_KC70_LEFT

config ZMK_KEYBOARD_NAME
    default "kc70"

config ZMK_SPLIT_ROLE_CENTRAL
    default y

endif

if BOARD_KC70_LEFT || BOARD_KC70_RIGHT

config BOARD
    default "kc70"

config ZMK_SPLIT
    default y

config BT_CTLR
    default BT

if USB_DEVICE_STACK

config USB_NRFX
    default y

endif # USB

config BQ274XX
    default y

config ZMK_BATTERY_NRF_VDDH
    default y

endif
```

## config/boards/shields/corne-choc-xiao/Kconfig.defconfig
```kconfig
if SHIELD_CORNE_CHOC_XIAO_LEFT

config ZMK_KEYBOARD_NAME
    default "Corne-xiao"

config ZMK_SPLIT_ROLE_CENTRAL
    default y

endif

if SHIELD_CORNE_CHOC_XIAO_LEFT || SHIELD_CORNE_CHOC_XIAO_RIGHT

config ZMK_SPLIT
    default y

endif
```

## config/boards/shields/corne-choc-xiao/Kconfig.shield
```kconfig
config SHIELD_CORNE_CHOC_XIAO_LEFT
    def_bool $(shields_list_contains,corne_choc_xiao_left)

config SHIELD_CORNE_CHOC_XIAO_RIGHT
    def_bool $(shields_list_contains,corne_choc_xiao_right)
```

## config/boards/shields/pinnacletest/Kconfig.defconfig
```kconfig
if SHIELD_PINNACLETEST

config ZMK_KEYBOARD_NAME
    default "PINNACLETEST"

endif
```

## config/west.yml
```yaml
manifest:
  remotes:
    - name: zmkfirmware
      url-base: https://github.com/drorchen
  projects:
    - name: zmk
      remote: zmkfirmware
      revision: trackball-support
      import: app/west.yml
  self:
    path: config
```
